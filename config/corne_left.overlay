#include "corne.dtsi"
#include <input/processors.dtsi>

&tps43_listener {
    status = "okay";

    high_sens_override {
        layers = <12>;
        input-processors = <&zip_xy_scaler 2 1>;
    };

    low_sens_override {
        layers = <13>;
        input-processors = <&zip_xy_scaler 1 2>;
    };
};
