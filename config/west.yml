## config/west.yml
```yaml
manifest:
  remotes:
    - name: zmkfirmware
      url-base: https://github.com/zmkfirmware
    - name: essenceotd
      url-base: https://github.com/essenceotd
    - name: zzeneg
      url-base: https://github.com/zzeneg
  projects:
    - name: zmk
      remote: zmkfirmware
      revision: main
      import: app/west.yml
    - name: zmk_driver_azoteq
      remote: essenceotd
      revision: main
    - name: zmk-raw-hid
      remote: zzeneg
      revision: main
  self:
    path: config
```

## dts/bindings/behaviors/zmk,behavior-bt-cycle.yaml
```yaml
description: |
  Switches to the next Bluetooth profile that has a host paired, skipping
  empty profiles. Set reverse to go to the previous one instead.

compatible: "zmk,behavior-bt-cycle"

include: zero_param.yaml

properties:
  reverse:
    type: boolean
    description: Go to the previous paired profile instead of the next.
```

## dts/bindings/behaviors/zmk,behavior-trackpad-toggle.yaml
```yaml
description: |
  Turns the TPS43 trackpad on or off. Runs on every half; the half with the
  trackpad saves the state so it is kept through sleep and power cycles.

compatible: "zmk,behavior-trackpad-toggle"

include: zero_param.yaml
```

## dts/bindings/input_processors/zmk,input-processor-tap-drag.yaml
```yaml
description: |
  Laptop-style tap, tap-and-drag and double tap for trackpads that report
  INPUT_BTN_TOUCH while a finger is down and INPUT_BTN_0 for taps.

compatible: "zmk,input-processor-tap-drag"

include: ip_zero_param.yaml

properties:
  window-ms:
    type: int
    default: 200
    description: |
      How long after a tap a new touch turns into a drag. Single-tap clicks
      are sent this long after the tap.
```

## dts/bindings/input_processors/zmk,input-processor-trackpad-gate.yaml
```yaml
description: |
  Drops trackpad input while &tp_toggle has the trackpad turned off. Button
  releases still pass so nothing is left held down.

compatible: "zmk,input-processor-trackpad-gate"

include: ip_zero_param.yaml
```

## modules/Kconfig
```kconfig
rsource "null_keys_viz/Kconfig"
rsource "tap_drag/Kconfig"
rsource "trackpad_toggle/Kconfig"
rsource "bt_cycle/Kconfig"
```

## modules/null_keys_viz/Kconfig
```kconfig
config NULL_KEYS_VIZ
    bool "Stream key positions and layer state to the Null Keys overlay"
    default y
    depends on RAW_HID

if NULL_KEYS_VIZ

config NULL_KEYS_VIZ_HOST_TIMEOUT_MS
    int "Stop streaming after this long without a host subscribe (ms)"
    default 6000

config NULL_KEYS_VIZ_QUEUE_SIZE
    int "Pending report queue length"
    default 32

endif
```

## modules/tap_drag/Kconfig
```kconfig
config ZMK_INPUT_PROCESSOR_TAP_DRAG
    bool "Laptop-style tap, tap-and-drag and double tap input processor"
    default y
    depends on DT_HAS_ZMK_INPUT_PROCESSOR_TAP_DRAG_ENABLED
```

## modules/trackpad_toggle/Kconfig
```kconfig
config ZMK_TRACKPAD_TOGGLE
    bool "Trackpad on/off toggle behavior that remembers its state"
    default y
    depends on DT_HAS_ZMK_BEHAVIOR_TRACKPAD_TOGGLE_ENABLED
```
